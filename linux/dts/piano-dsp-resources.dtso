// SPDX-License-Identifier: GPL-2.0-or-later OR MIT
/dts-v1/;
/plugin/;

/ {
	fragment@0 {
		target-path = "/soc/remoteproc-cdsp@32300000";
		__overlay__ {
			compatible = "qcom,sm8750-cdsp-pas";
			clocks = <&rpmhcc_ml 0>;
			clock-names = "xo";
			/* RPMHPD_CX, RPMHPD_MXC, RPMHPD_NSP from sm8750.dtsi. */
			power-domains = <&rpmhpd_ml 0>,
					<&rpmhpd_ml 10>,
					<&rpmhpd_ml 13>;
			power-domain-names = "cx", "mxc", "nsp";
			/* MASTER_CDSP_PROC=0, SLAVE_EBI1=1, TAG_ALWAYS=7. */
			interconnects = <&nsp_noc 0 7 &mc_virt 1 7>;
			interconnect-names = "rproc_ddr";
		};
	};

	fragment@1 {
		target-path = "/soc/remoteproc-adsp@03000000";
		__overlay__ {
			clocks = <&rpmhcc_ml 0>;
			clock-names = "xo";
		};
	};

	fragment@2 {
		target-path = "/soc/interconnect@320c0000";
		__overlay__ {
			compatible = "qcom,sm8750-nsp-noc";
			#interconnect-cells = <2>;
			qcom,bcm-voters = <&apps_bcm_voter_ml>;
		};
	};
};
